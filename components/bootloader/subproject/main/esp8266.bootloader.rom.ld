PROVIDE ( ets_memcpy = 0x400018b4 );
PROVIDE ( ets_printf = 0x400024cc );

PROVIDE ( SPIRead = 0x40004b1c );
PROVIDE ( SPIEraseBlock = 0x400049b4 );
PROVIDE ( SPIEraseChip = 0x40004984 );
PROVIDE ( SPIEraseSector = 0x40004a00 );
PROVIDE ( SPIUnlock = 0x40004878 );
PROVIDE ( SPIWrite = 0x40004a4c );
PROVIDE ( software_reset = 0x4000264c );
